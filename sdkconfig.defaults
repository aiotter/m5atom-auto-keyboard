## sdkconfig.defaults
```kconfig
# Rust often needs a bit of an extra main task stack size compared to C (the default is 3K)
CONFIG_ESP_MAIN_TASK_STACK_SIZE=8000

# Use this to set FreeRTOS kernel tick frequency to 1000 Hz (100 Hz by default).
# This allows to use 1 ms granuality for thread sleeps (10 ms by default).
#CONFIG_FREERTOS_HZ=1000

CONFIG_ESP_CONSOLE_UART_CUSTOM=y
# CONFIG_ESP_CONSOLE_UART=y
# CONFIG_ESP_CONSOLE_UART_CUSTOM_NUM_1=y
CONFIG_ESP_CONSOLE_UART_NUM=1
CONFIG_ESP_CONSOLE_ROM_SERIAL_PORT_NUM=1

# Not working because of unknown reason
# CONFIG_ESP_CONSOLE_UART_TX_GPIO=42
# CONFIG_ESP_CONSOLE_UART_RX_GPIO=40
# CONFIG_ESP_CONSOLE_UART_BAUDRATE=115200

# Workaround for https://github.com/espressif/esp-idf/issues/7631
#CONFIG_MBEDTLS_CERTIFICATE_BUNDLE=n
#CONFIG_MBEDTLS_CERTIFICATE_BUNDLE_DEFAULT_FULL=n

# TinyUSB configuration
CONFIG_TINYUSB_DEBUG_LEVEL=1
CONFIG_TINYUSB=y
CONFIG_TINYUSB_TASK_PRIORITY=5
CONFIG_TINYUSB_TASK_STACK_SIZE=4096
CONFIG_TINYUSB_TASK_AFFINITY_NO_AFFINITY=y
CONFIG_TINYUSB_DFU_MODE_NONE=y
# TINYUSB_DFU_MODE_DFU=y
CONFIG_TINYUSB_NET_MODE_NONE=y
CONFIG_TINYUSB_HID_ENABLED=y
CONFIG_TINYUSB_HID_COUNT=1
CONFIG_TINYUSB_HID_BUFSIZE=64

CONFIG_TINYUSB_DESC_USE_ESPRESSIF_VID=y
CONFIG_TINYUSB_DESC_USE_DEFAULT_PID=y
CONFIG_TINYUSB_DESC_BCD_DEVICE=0x0100
CONFIG_TINYUSB_DESC_MANUFACTURER_STRING="aiotter"
CONFIG_TINYUSB_DESC_PRODUCT_STRING="bluetooth-keyboard"
CONFIG_TINYUSB_DESC_SERIAL_STRING="123456"

CONFIG_TINYUSB_MSC_ENABLED=y
CONFIG_TINYUSB_DESC_MSC_STRING="Auto-keyboard"

# Currently you cannot enable CDC
# https://github.com/rust-lang/rust-bindgen/issues/2179
# https://github.com/esp-rs/esp-idf-sys/issues/183
# CONFIG_TINYUSB_CDC_ENABLED=y

CONFIG_WL_SECTOR_SIZE_512=y
CONFIG_WL_SECTOR_MODE_PERF=y

CONFIG_FATFS_LFN_HEAP=y
```
